/******************************************************************************************
 * FileName     : SmartLight_iot.ino
 * Description  : ETboard Smart Light IoT / 이티보드 스마트 가로등 IoT 버전
 * Author       : SCS
 * Created Date : 2022.08.06
 * Reference    : 
 * Modified     : 
 * Modified     : 
******************************************************************************************/

//==========================================================================================
// 응용 프로그램 구성 사용하기                       
//==========================================================================================
#include "app_config.h"
APP_CONFIG app;


//==========================================================================================
// 상수 정의                                       
//==========================================================================================
// 메시지 송신 주기 : 주의!!!! 너무 빨리 또는 많이 보내면 서버에서 거부할 수 있음(Banned)
//------------------------------------------------------------------------------------------
#define NORMAL_SEND_INTERVAL  (1000 * 1)          // 1초 (단위: 초/1000)


//================================================-=========================================
// 전역 변수 선언                                   
//==========================================================================================
int TRIG = D9;                                    // 초음파 송신 핀
int ECHO = D8;                                    // 초음파 수신 핀
int brightness_value;                             // 조도 센서 값(밝기)
int distance_value;                               // 초음파 센서 값(거리)


//==========================================================================================
void setup()                                      // 설정 (수정 금지, custom_setup에서 수정 권장)
//==========================================================================================
{
  app.setup();                                    // 응용 프로그램 기본 설정

  custom_setup();                                 // 사용자 맞춤형 설정
}


//==========================================================================================
void custom_setup()                               // 사용자 맞춤형 설정 정의
//==========================================================================================
{
  //----------------------------------------------------------------------------------------
  // 아래에 사용자 맞춤형 설정을 하세요               
  //----------------------------------------------------------------------------------------
  // 초음파 센서 핀 설정                            
  //----------------------------------------------------------------------------------------
  pinMode(TRIG, OUTPUT);                          // 초음파 송신 핀을 출력 모드로 설정
  pinMode(ECHO, INPUT);                           // 초음파 수신 핀을 입력 모드로 설정
}


//==========================================================================================
void loop()                                       // 반복 루틴
//==========================================================================================
{
  //----------------------------------------------------------------------------------------
  // MQTT 백그라운드 동작 
  //----------------------------------------------------------------------------------------
  app.mqtt.loop();
    
  //----------------------------------------------------------------------------------------
  // NORMAL_SEND_INTERVAL 만큼 주기적으로 동작
  //----------------------------------------------------------------------------------------
  if (millis() - app.lastMillis > NORMAL_SEND_INTERVAL) {  
      send_distance();                            // 거리 값 송신
      send_brightness();                          // 조도 값 송신
      app.lastMillis = millis();                  // 현재 시각 갱신
   }  

  //----------------------------------------------------------------------------------------
  // 디지털 값이 변경되었으면 바로 송신
  //----------------------------------------------------------------------------------------    
   if (app.mqtt.is_changed_digital() == true) {   // 디지털 값이 변경 여부
      app.mqtt.send_digital();                    // 디지털 값을 송신
   }

  //----------------------------------------------------------------------------------------
  // 동작 모드가 자동일 경우
  //----------------------------------------------------------------------------------------      
  if(app.operation_mode == "automatic") {
    do_automatic_process();                       // 자동화 처리
    //app.mqtt.send_digital();                      // 디지털 값을 송신
  }
  
  //----------------------------------------------------------------------------------------
  // Blink Operation LED
  //----------------------------------------------------------------------------------------  
  app.etboard.normal_blink_led();                 // 동작 상태 LED 깜밖이기
}


//==========================================================================================
void onConnectionEstablished()                    // MQTT 연결되었을 때 동작
//==========================================================================================
{
  app.mqtt.onConnectionEstablished();             // MQTT 연결되었을 때 동작
  recv_automatic_mode();
}


//==========================================================================================
void send_distance()                              // 거리 값 송신
//==========================================================================================
{ 
  //----------------------------------------------------------------------------------------
  // 초음파 센서 설정
  //----------------------------------------------------------------------------------------  
  pinMode(TRIG, OUTPUT);                          // TRIG 핀을 출력 모드로 설정
  pinMode(ECHO, INPUT);                           // ECHO 핀을 입력 모드로 설정
  delay(10);                                      // 10/1000초 만큼 대기
  
  //----------------------------------------------------------------------------------------
  // 초음파 측정
  //----------------------------------------------------------------------------------------  
  digitalWrite(TRIG, LOW);
  digitalWrite(ECHO, LOW);
  delayMicroseconds(2);
  digitalWrite(TRIG, HIGH);
  delayMicroseconds(10);
  digitalWrite(TRIG, LOW);
  
  //----------------------------------------------------------------------------------------
  // 초음파 수신 값으로 거리 계산
  //----------------------------------------------------------------------------------------  
  float duration = pulseIn (ECHO, HIGH);      
  float distance = duration * 17 / 1000;
  distance_value = distance;

  //----------------------------------------------------------------------------------------
  // 메시지 송신
  //----------------------------------------------------------------------------------------  
  String string_d = String(distance, 2);          // 소수점 2자리 문자열로 변환
  app.mqtt.publish("/distance", String(string_d));// 거리 값을 송신
}


//==========================================================================================
void send_brightness()                            // 조도 값을 송신 (밝기)
//==========================================================================================
{ 
  delay(20);                                      // 20/1000초 대기

  int cds = 0;                                    // 조도 변수 초기화
  cds = analogRead(A3);                           // 조도 센서 읽기
  brightness_value = cds;                         // 조도 값 저장
  
  app.mqtt.publish("/brightness", String(cds));   // 조도 값을 송신
}

//=================================================================================
void recv_automatic_mode(void)                    // 동작 모드 수신
//=================================================================================
{
  app.mqtt.client.subscribe(app.mqtt.get_topic_prefix() + "/operation_mode", [&](const String & payload) {
    pinMode(D5, OUTPUT);
    if (payload == "automatic"){
      app.operation_mode = "automatic";
      digitalWrite(D5, HIGH);
    }
    else{
      app.operation_mode = "manual";
      digitalWrite(D5, LOW);
      }
    });
}


//==========================================================================================
void do_automatic_process()                       // 자동화 처리
//==========================================================================================
{
  pinMode(D2, OUTPUT);                            // D2핀을 출력 모드로 설정
  pinMode(D3, OUTPUT);                            // D3핀을 출력 모도로 설정
  
  if (brightness_value < 2000) {                  // 밝기가 2000 미만이면
    digitalWrite(D3, HIGH);                       // D3핀을 켜기
    
    if (distance_value < 8) {                     // 거리가 8cm 미만이면
      digitalWrite(D2, HIGH);                     // D2핀을 켜기
    }
    else {                                        // 그렇지 않으면
      digitalWrite(D2, LOW);                      // D2핀을 끄기
    }
    
  }
  else {                                          // 그렇지 않으면
    digitalWrite(D2, LOW);                        // D2를 끄기
    digitalWrite(D3, LOW);                        // D3를 끄기
  }
}


//==========================================================================================
//                                                    
// (주)한국공학기술연구원 http://et.ketri.re.kr       
//                                                    
//==========================================================================================
