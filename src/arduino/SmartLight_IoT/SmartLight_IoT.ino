/******************************************************************************************
 * FileName     : SmartLight_iot.ino
 * Description  : 이티보드 스마트 가로등 코딩 키트(IoT)
 * Author       : SCS
 * Created Date : 2022.08.06
 * Reference    : 
 * Modified     : 2022.08.10 : SCS
 * Modified     : 2022.12.28 : YSY : 변수 명명법 통일
******************************************************************************************/
const char* board_hardware_verion = "ETBoard_V1.1";
const char* board_firmware_verion = "smartLgt_0.91";

//================================================-=========================================
// 응용 프로그램 구성 사용하기                       
//==========================================================================================
#include "app_config.h"
APP_CONFIG app;


//==========================================================================================
// 상수 정의                                       
//==========================================================================================
// 메시지 송신 주기 : 주의!!!! 너무 빨리 또는 많이 보내면 서버에서 거부할 수 있음(Banned)
//------------------------------------------------------------------------------------------
#define NORMAL_SEND_INTERVAL  (1000 * 5)                       // 권장 5초 (단위: 초/1000)


//==========================================================================================
// ETBoard 핀번호 설정                                
//==========================================================================================
const int cds_pin  = A3;                                       // 조도 센서
const int echo_pin = D8;                                       // 초음파 수신 핀
const int trig_pin = D9;                                       // 초음파 송신 핀

const int green_led = D2;                                      // 가로등 녹색 LED
const int blue_led  = D3;                                      // 가로등 파란색 LED

int operation_mode_led = D4;                                   // 작동 모드 LED

const int cds_threshold = 800;                                 // 조도 센서 임계치
const int usw_threshold = 10;                                  // 초음파 센서 임계치

int cds_value;                                                 // 조도 센서 값(밝기)
float distance_value;                                          // 초음파 센서 값(거리)


//==========================================================================================
void setup()                                                   // 설정 함수 
//==========================================================================================
// (권장 사항) 이 함수에서는 코딩하지 마십시오. custom_setup()에 코딩하십시오.
//------------------------------------------------------------------------------------------
{
    app.setup();                                               // 응용 프로그램 기본 설정

    custom_setup();                                            // 사용자 맞춤형 설정
}


//==========================================================================================
void custom_setup()                                            // 사용자 맞춤형 설정 함수
//==========================================================================================
{
    //--------------------------------------------------------------------------------------
    // 여기에 사용자 맞춤형 설정을 코딩하세요.
    //--------------------------------------------------------------------------------------
    // 초음파 센서 핀 설정                            
    //--------------------------------------------------------------------------------------
    pinMode(trig_pin, OUTPUT);                                 // 초음파 센서 송신부 출력 모드 설정
    pinMode(echo_pin, INPUT);                                  // 초음파 센서 수신부 입력 모드 설정
}


//==========================================================================================
void loop()                                                    // 반복 루틴
//==========================================================================================
//  (권장 사항) 이 함수를 가능하면 수정하지 마십시오 !!! 
//  do_sensing_process(), do_automatic_process(), send_sensor_value(), 
//  send_digital_output_value()를 수정하십시오.
//------------------------------------------------------------------------------------------
{
    //--------------------------------------------------------------------------------------
    // MQTT 백그라운드 동작 
    //--------------------------------------------------------------------------------------
    app.mqtt.loop();

    //--------------------------------------------------------------------------------------
    // 센싱 처리
    //--------------------------------------------------------------------------------------       
    do_sensing_process();                             

    //--------------------------------------------------------------------------------------
    // 동작 모드가 automatic 일 경우 자동화 처리
    //--------------------------------------------------------------------------------------      
    if(app.operation_mode == "automatic") {                    // 수정 금지
        do_automatic_process();                                // 자동화 처리    
    }
    
    //--------------------------------------------------------------------------------------
    // 주기적으로 메시지 전송 처리
    //--------------------------------------------------------------------------------------
    if (millis() - app.lastMillis > NORMAL_SEND_INTERVAL) {  
        send_sensor_value();                                   // 센서 값 송신
        app.lastMillis = millis();                             // 현재 시각 업데이트
    }  

    //----------------------------------------------------------------------------------------
    // 디지털 값이 변경되었으면 바로 송신
    //----------------------------------------------------------------------------------------    
    if (app.isChanged_digital_value() == true) {               // 디지털 값이 변경 여부
        send_digital_output_value();                           // 디지털 출력 값 송신
    }

    //--------------------------------------------------------------------------------------
    // 동작 상태 LED 깜밖이기
    //--------------------------------------------------------------------------------------  
    app.etboard.normal_blink_led();               
}


//==========================================================================================
void do_sensing_process()                                      // 센싱 처리 함수
//==========================================================================================
{ 
    //--------------------------------------------------------------------------------------
    // 조도 값 센싱하기; CDS 센서
    //--------------------------------------------------------------------------------------  
    cds_value = analogRead(cds_pin);                           // 조도 센서 읽기

    //--------------------------------------------------------------------------------------
    // 거리 값 센싱하기; 초음파 센서
    //--------------------------------------------------------------------------------------  
    pinMode(trig_pin, OUTPUT);                                 // trig_pin 핀을 출력 모드로 설정
    pinMode(echo_pin, INPUT);                                  // echo_pin 핀을 입력 모드로 설정
    delay(10);                                                 // 10/1000초 만큼 대기
  
    //--------------------------------------------------------------------------------------
    // 초음파 측정
    //--------------------------------------------------------------------------------------  
    digitalWrite(trig_pin, LOW);
    digitalWrite(echo_pin, LOW);
    delayMicroseconds(2);
    digitalWrite(trig_pin, HIGH);
    delayMicroseconds(10);
    digitalWrite(trig_pin, LOW);
  
    //--------------------------------------------------------------------------------------
    // 초음파 수신 값으로 거리 계산
    //--------------------------------------------------------------------------------------  
    float duration = pulseIn (echo_pin, HIGH);      
    distance_value = duration * 17 / 1000;  
}


//==========================================================================================
void do_automatic_process()                                    // 자동화 처리 함수
//==========================================================================================
// 여기에 자동화 처리를 코딩하세요.
//------------------------------------------------------------------------------------------
{  
    //--------------------------------------------------------------------------------------  
    // 가로등 모듈의 LED 제어
    //--------------------------------------------------------------------------------------  
    pinMode(green_led, OUTPUT);                                // green_led핀을 출력 모드로 설정
    pinMode(blue_led, OUTPUT);                                 // blue_led핀을 출력 모도로 설정
    
    if (cds_value < cds_threshold){                            // 밝기가 cds_threshold 미만이면
        digitalWrite(green_led, HIGH);                         // green_led핀을 켜기
        app.dg_Write(green_led, HIGH);                         // green_led핀 값 저장하기
    }
        else {                                                 // 그렇지 않으면
            digitalWrite(green_led, LOW);                      // green_led핀을 끄기
            app.dg_Write(green_led, LOW);                      // green_led핀 값 저장하기
        } 
  
    if (distance_value < usw_threshold){                       // 거리가 usw_threshold 미만이면
        digitalWrite(blue_led, HIGH);                          // blue_led핀을 켜기
        app.dg_Write(blue_led, HIGH);                          // blue_led핀 값 저장하기
    }
        else {                                                 // 그렇지 않으면
            digitalWrite(blue_led, LOW);                       // blue_led핀을 끄기
            app.dg_Write(blue_led, LOW);                       // blue_led핀 값 저장하기            
        }   
}


//==========================================================================================
void send_sensor_value()                                       // 센서 값 송신 함수
//==========================================================================================
{ 
    // 예시 {"distance":88.08,"brightness":2914} 
    DynamicJsonDocument doc(256);                              // json 
    doc["distance"] = app.etboard.round2(distance_value);      // 거리 값 송신, 소수점 2자리
    doc["brightness"] = cds_value;                             // 조도 값 송신

    String output;                                             // 문자열 변수
    serializeJson(doc, output);                                // json을 문자열로 변환
    app.mqtt.publish_tele("/sensor", output);                  // 송신
}


//==========================================================================================
void send_digital_output_value()                               // 디지털 출력 값 송신 함수
//==========================================================================================
{
    // 예시 {"green_led":0,"blue_led":0
    DynamicJsonDocument doc(256);                              // json 
    doc["green_led"] = app.dg_Read(green_led);                 // green_led 핀 값
    doc["blue_led"] = app.dg_Read(blue_led);                   // blue_led 핀 값
    
    String output;                                             // 문자열 변수
    serializeJson(doc, output);                                // json을 문자열로 변환
    app.mqtt.publish_tele("/digital_output", output);          // 송신
  
    app.update_digital_value();
  
    delay(100);
}


//==========================================================================================
void onConnectionEstablished()                                 // MQTT 연결되었을 때 동작하는 함수
//==========================================================================================
{
    app.mqtt.onConnectionEstablished();                        // MQTT 연결되었을 때 동작
    recv_automatic_mode();                                     // 동작 모스 수신 설정
}


//==========================================================================================
void recv_automatic_mode(void)                                 // 작동 모드 수신 함수
//==========================================================================================
{
    app.mqtt.client.subscribe(
        app.mqtt.get_cmnd_prefix() + "/operation_mode",        // 작동 모드 명령을 수신
        [&](const String & payload) {                          // 명령 내용을 payload에 저장       
            pinMode(operation_mode_led, OUTPUT);               // operation_mode_led 핀을 출력 모드로 설정
            if (payload == "automatic"){                       // 명령이 자동이면
                app.operation_mode = "automatic";              // 작동 모드를 자동으로 설정
                digitalWrite(operation_mode_led, HIGH);        // 작동 모드 LED 켜기
            }
            else{
                app.operation_mode = "manual";                 // 작동 모드를 수동으로 설정
                digitalWrite(operation_mode_led, LOW);         // 작동 모드 LED 끄기
            }
        });

        app.mqtt.client.subscribe(
            app.mqtt.get_cmnd_prefix() + "/green_led",         // 작동 모드 명령을 수신
            [&](const String & payload) {                      // 명령 내용을 payload에 저장       
                if (payload == "1"){                           // 명령이 자동이면
                    digitalWrite(green_led, HIGH);             // 작동 모드 LED 켜기
                }
                else{
                    digitalWrite(green_led, LOW);              // 작동 모드 LED 끄기
                }
        });

            app.mqtt.client.subscribe(
        app.mqtt.get_cmnd_prefix() + "/blue_led",              // 작동 모드 명령을 수신
        [&](const String & payload) {                          // 명령 내용을 payload에 저장       
            if (payload == "1"){                               // 명령이 자동이면
                digitalWrite(blue_led, HIGH);                  // 작동 모드 LED 켜기
            }
            else{
                digitalWrite(blue_led, LOW);                   // 작동 모드 LED 끄기
            }
        });    
}

//==========================================================================================
//                                                    
// (주)한국공학기술연구원 http://et.ketri.re.kr       
//                                                    
//==========================================================================================
